## drivers/char/beep/Kconfig
```kconfig
config X6818_BEEP_DRIVER
	bool "X6818 beep driver"
	default y
	help
	compile for leddriver,y for kernel,m for module.
```

## drivers/char/humity/Kconfig
```kconfig
config X6818_HUMITY_DRIVER
	bool "X6818 humity driver"
	default n
	help
	compile for leddriver,y for kernel,m for module.
```

## drivers/char/led/Kconfig
```kconfig
config X6818_LED_DRIVER
	bool "X6818 led driver"
	default n
	help
	compile for leddriver,y for kernel,m for module.
```
